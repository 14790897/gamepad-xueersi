## sdkconfig.defaults
```kconfig
# ESP32 base config
CONFIG_IDF_TARGET="esp32"
CONFIG_ESPTOOLPY_FLASHSIZE_4MB=y
CONFIG_ESPTOOLPY_FLASHSIZE="4MB"
CONFIG_ESP32_DEFAULT_CPU_FREQ_240=y
CONFIG_ESP32_DEFAULT_CPU_FREQ_MHZ=240

# FreeRTOS
CONFIG_FREERTOS_HZ=1000
CONFIG_FREERTOS_UNICORE=n

# SPI peripheral
CONFIG_SPI_MASTER_ISR_IN_IRAM=y

# Log level
CONFIG_LOG_DEFAULT_LEVEL_INFO=y
CONFIG_LOG_MAXIMUM_LEVEL_INFO=y

# Partition table
CONFIG_PARTITION_TABLE_SINGLE_APP=y

# Main task stack size
CONFIG_ESP_MAIN_TASK_STACK_SIZE=8192
```
